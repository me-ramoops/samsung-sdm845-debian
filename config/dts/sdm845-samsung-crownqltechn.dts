// SPDX-License-Identifier: GPL-2.0
/*
 * SDM845 Samsung Galaxy Note 9 (SM-N9600) (crownqltechn) device tree source
 *
 * Copyright (c) 2020, The Linux Foundation. All rights reserved.
 */

/dts-v1/;

#include "sdm845-samsung-star-common.dtsi"

/ {
	model = "Samsung Galaxy Note 9 SM-N9600";
	compatible = "samsung,crownqltechn", "qcom,sdm845";

	battery: battery {
		charge-full-design-microamp-hours = <4000000>;
	};
};
